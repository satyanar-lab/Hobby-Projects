AUTOSAR XML (schema 00050)
package /body_control/lighting/si
  service interface OperatorService: category=0x5200
    methods:
      7 x operation:
        RequestLampToggle: category=0x0001
          arg lamp_function: type=LampFunction, direction=IN
        RequestLampActivate: category=0x0002
          arg lamp_function: type=LampFunction, direction=IN
        RequestLampDeactivate: category=0x0003
          arg lamp_function: type=LampFunction, direction=IN
        RequestNodeHealth: category=0x0004
          arg node_health: type=NodeHealthStatus, direction=OUT
        RequestInjectFault: category=0x0005
          arg lamp_function: type=LampFunction, direction=IN
        RequestClearFault: category=0x0006
          arg lamp_function: type=LampFunction, direction=IN
        RequestGetFaultStatus: category=0x0007
          arg lamp_fault_status: type=LampFaultStatus, direction=OUT
    events:
      data LampStatusUpdated: category=0x8001, type=LampStatus
      data NodeHealthUpdated: category=0x8002, type=NodeHealthStatus
