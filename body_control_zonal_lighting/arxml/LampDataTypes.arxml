AUTOSAR XML (schema 00050)
package /body_control/lighting/dt
  compu method LampFunction: 0=kUnknown, 1=kLeftIndicator, 2=kRightIndicator, 3=kHazardLamp, 4=kParkLamp, 5=kHeadLamp
  compu method LampCommandAction: 0=kNoAction, 1=kActivate, 2=kDeactivate, 3=kToggle
  compu method CommandSource: 0=kUnknown, 1=kHmiControlPanel, 2=kDiagnosticConsole, 3=kCentralZoneController
  compu method LampOutputState: 0=kUnknown, 1=kOff, 2=kOn
  compu method NodeHealthState: 0=kUnknown, 1=kOperational, 2=kDegraded, 3=kFaulted, 4=kUnavailable
  compu method FaultCode: 0=kNoFault, 45057=kLeftIndicator, 45058=kRightIndicator, 45059=kHazardLamp, 45060=kParkLamp, 45061=kHeadLamp
  compu method FaultAction: 0=kUnknown, 1=kInject, 2=kClear
  5 x impl type, all with category=STRUCTURE:
    LampCommand
      4 x element:
        function: implementation-data-type=LampFunction
        action: implementation-data-type=LampCommandAction
        source: implementation-data-type=CommandSource
        sequence_counter: category=VALUE, base-type=uint16
    LampStatus
      4 x element:
        function: implementation-data-type=LampFunction
        output_state: implementation-data-type=LampOutputState
        command_applied: category=VALUE, base-type=boolean
        last_sequence_counter: category=VALUE, base-type=uint16
    NodeHealthStatus
      5 x element:
        health_state: implementation-data-type=NodeHealthState
        ethernet_link_available: category=VALUE, base-type=boolean
        service_available: category=VALUE, base-type=boolean
        lamp_driver_fault_present: category=VALUE, base-type=boolean
        active_fault_count: category=VALUE, base-type=uint16
    LampFaultStatus
      element fault_present: category=VALUE, base-type=boolean
      element active_fault_count: category=VALUE, base-type=uint8
      element active_faults: category=ARRAY, array-size=5, array-size-semantics=FIXED-SIZE
        element element: implementation-data-type=FaultCode
    FaultCommand
      4 x element:
        function: implementation-data-type=LampFunction
        action: implementation-data-type=FaultAction
        source: implementation-data-type=CommandSource
        sequence_counter: category=VALUE, base-type=uint16
