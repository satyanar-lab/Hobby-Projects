AUTOSAR XML (schema 00050)
package /body_control/lighting/si
  service interface ExteriorLightingService: category=0x5100
    methods:
      6 x operation:
        SetLampCommand: category=0x0001
          arg lamp_command: type=LampCommand, direction=IN
        GetLampStatus: category=0x0002
          arg lamp_function: type=LampFunction, direction=IN
          arg lamp_status: type=LampStatus, direction=OUT
        GetNodeHealth: category=0x0003
          arg node_health: type=NodeHealthStatus, direction=OUT
        InjectFault: category=0x0004
          arg fault_command: type=FaultCommand, direction=IN
        ClearFault: category=0x0005
          arg fault_command: type=FaultCommand, direction=IN
        GetFaultStatus: category=0x0006
          arg lamp_fault_status: type=LampFaultStatus, direction=OUT
    events:
      data LampStatusEvent: category=0x8001, type=LampStatus
      data NodeHealthStatusEvent: category=0x8002, type=NodeHealthStatus
      data FaultStatusEvent: category=0x8003, type=LampFaultStatus
